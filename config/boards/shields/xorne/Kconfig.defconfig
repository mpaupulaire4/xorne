## config/boards/shields/xorne/Kconfig.defconfig
```kconfig
# Copyright (c) 2020 The ZMK Contributors
# SPDX-License-Identifier: MIT

if SHIELD_XORNE_DONGLE

config ZMK_KEYBOARD_NAME
	default "Xorne"

config ZMK_SPLIT_BLE_ROLE_CENTRAL
	default y

config ZMK_USB
	default y

endif

if SHIELD_XORNE_LEFT || SHIELD_XORNE_RIGHT || SHIELD_XORNE_DONGLE

config ZMK_SPLIT
	default y

config ZMK_BLE
	default y

endif
```
